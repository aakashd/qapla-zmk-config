## boards/shields/qapla/Kconfig.shield
```kconfig
config SHIELD_QAPLA_LEFT
    def_bool $(shields_list_contains,qapla_left)

config SHIELD_QAPLA_RIGHT
    def_bool $(shields_list_contains,qapla_right)
```
